## config/boards/shields/SW_sweep/Kconfig.defconfig
```kconfig
if SHIELD_SW_SWEEP_LEFT

config ZMK_KEYBOARD_NAME
    default "SW_sweep"

config ZMK_SPLIT_ROLE_CENTRAL
    default y

endif

if SHIELD_SW_SWEEP_LEFT || SHIELD_SW_SWEEP_RIGHT

config ZMK_SPLIT
    default y

endif
```

## config/boards/shields/SW_sweep/Kconfig.shield
```kconfig
config SHIELD_SW_SWEEP_LEFT
    def_bool $(shields_list_contains,SW_sweep_left)

config SHIELD_SW_SWEEP_RIGHT
    def_bool $(shields_list_contains,SW_sweep_right)
```
